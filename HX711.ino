/*
 * Тарирование – это процесс установки нулевого значения веса, когда на весах нет нагрузки.
 * Это важно для точности последующих измерений веса.
*/

//================================================================================================================================
void Init_HX711()                                           // 
{
  LoadCell.begin();											                    // Настраиваем HX711 (по умолчанию)
  //------------------------------------------------------------------------------------------------------------------------------
  LoadCell.start(2000, true);								                // Запускаем модуль HX711
  //------------------------------------------------------------------------------------------------------------------------------
  tft.setTextColor(TFT_WHITE, TFT_BLACK);					          // Установить цвет текста
  tft.print("Tare_HX7111: ");                               // 
  //------------------------------------------------------------------------------------------------------------------------------
  if (LoadCell.getTareTimeoutFlag())						            // Проверям наличие модуля HX711
  {
	  flag_hx711 = false;									                    // Ошибка тарирования 
    tft.setTextColor(TFT_YELLOW, TFT_RED);					        // Установить цвет текста
    tft.println("OFF");                                     // 
  }
  else
  {
	  flag_hx711 = true;									                    // Тарирование успешно
    tft.setTextColor(TFT_BLACK, TFT_GREEN);					        // Установить цвет текста
    tft.println("ON");                                      // 
  }
  //------------------------------------------------------------------------------------------------------------------------------
  if (flag_hx711) LoadCell.setCalFactor(calibrationValue);	// Если тарирование успешно, то задать коллибровочные значение
  //------------------------------------------------------------------------------------------------------------------------------
  tft.setTextColor(TFT_WHITE, TFT_BLACK);					          // Установить цвет текста
  tft.print("calibrationValue: ");                          // 
  tft.println(calibrationValue);                            // 
}
//================================================================================================================================
void PrintLoad(uint16_t x, uint16_t y)                      // 
{
  if(flag_bitMap_hx711)                                     // 
  {
    tft.drawBitmap(x, y, bitmap_name, bitmap_name_width, bitmap_name_height, TFT_WHITE);
    flag_bitMap_hx711 = false;                              // 
  }
  //------------------------------------------------------------------------------------------------------------------------------
  if (LoadCell.update())											              // Если появились новые данные то...
  {
    if (millis() > t + serialPrintInterval)					        // 
    {
      int i = LoadCell.getData();							              // 
      //--------------------------------------------------------------------------------------------------------------------------
      tft.setTextColor(TFT_WHITE, TFT_BLACK);					      // Установить цвет текста
      tft.setTextSize(2);									                  // Установить размер символов
      //--------------------------------------------------------------------------------------------------------------------------
      if (i >= 0 && i <= 9)                                 // 
      {
        tft.setCursor(x - 10, y - 20);                      // Установить координату
      }
      else if (i >= 10 && i <= 99)                          // 
      {
        tft.setCursor(x - 15, y - 20);                      // Установить координату
      }
      else if (i >= 100 && i <= 999)                        // 
      {
        tft.setCursor(x - 20, y - 20);                      // Установить координату
      }
      else if (i >= 1000 && i <= 9999)                      // 
      {
        tft.setCursor(x - 25, y - 20);                      // Установить координату
      }
      else                                                  // 
      {
        tft.setCursor(x - 10, y - 20);                      // Установить координату
      }
      //--------------------------------------------------------------------------------------------------------------------------
      tft.print("   ");                                     // 
      (i >= 0) ? tft.print(i) : tft.print('0');							// Вывести на дисплей значение веса (в кг)
      tft.print("   ");                                     // 
      //--------------------------------------------------------------------------------------------------------------------------
      if (i >= 0 && old_LoadCell != i)                      // 
      {
        tft.fillRect(x, y + 1, 64, 4, TFT_RED);             // 

        String val_str = "0," + String(i) + ";";            // 
        Serial.println(val_str);                            // 
        //------------------------------------------------------------------------------------------------------------------------
        old_LoadCell = i;                                   // 
      }
      else
      {
        tft.fillRect(x, y + 1, 64, 4, TFT_WHITE);           // 
      }
      //--------------------------------------------------------------------------------------------------------------------------
      if (flag_tare_res)
      {
        tft.fillRect(x, y + 1, 64, 4, TFT_GREEN);           // 
        flag_tare_res = false;                              // 
      }
      //--------------------------------------------------------------------------------------------------------------------------
      t = millis();											                    // 
    }
  }
}